## configs/sample.yaml
```yaml
dataset_name: erbacher/LeanRank-data
random_seed: 42
use_huggingface: false
corpus:
  lean_version: unknown
  mathlib_commit: unknown
  extraction_pipeline: LeanRank synthetic-compatible sample
  source_revision: local
sample:
  total_rows: 60000
  small_debug_rows: 1000
  committed_demo_rows: 3000
split:
  train_ratio: 0.8
  val_ratio: 0.1
  test_ratio: 0.1
retrieval:
  top_k: [1, 5, 10]
similarity:
  theorem_top_k: 10
proof_techniques:
  max_labels_per_state: 5
  minimum_support: 1
embedding:
  backend: tfidf
  model_name: sentence-transformers/all-MiniLM-L6-v2
index:
  backend: sklearn
  metric: cosine
  n_neighbors: 100
  create_vector_index: false
index_benchmark:
  split: train
  top_k: 10
  query_count: 25
  seed: 42
```
